## main/Kconfig.projbuild
```kconfig
menu "Remote Power Controller"

config RPC_DEVICE_NAME
    string "Device name"
    default "esp32-power-controller"

config RPC_WIFI_SSID
    string "Wi-Fi SSID"
    default ""

config RPC_WIFI_PASSWORD
    string "Wi-Fi password"
    default ""

config RPC_WIFI_FALLBACK_AP_ENABLE
    bool "Enable fallback setup hotspot"
    default y

config RPC_WIFI_FALLBACK_AP_SSID
    string "Fallback setup hotspot SSID"
    default "esp32-power-controller-setup"
    depends on RPC_WIFI_FALLBACK_AP_ENABLE

config RPC_WIFI_FALLBACK_AP_PASSWORD
    string "Fallback setup hotspot password"
    default "esp32setup"
    depends on RPC_WIFI_FALLBACK_AP_ENABLE

config RPC_WIFI_FALLBACK_AP_CHANNEL
    int "Fallback setup hotspot channel"
    range 1 13
    default 1
    depends on RPC_WIFI_FALLBACK_AP_ENABLE

config RPC_WIFI_USE_STATIC_IP
    bool "Use static IPv4 for station Wi-Fi"
    default n

config RPC_WIFI_STATIC_IP
    string "Static IPv4 address"
    default "192.168.1.50"
    depends on RPC_WIFI_USE_STATIC_IP

config RPC_WIFI_STATIC_NETMASK
    string "Static IPv4 netmask"
    default "255.255.255.0"
    depends on RPC_WIFI_USE_STATIC_IP

config RPC_WIFI_STATIC_GATEWAY
    string "Static IPv4 gateway"
    default "192.168.1.1"
    depends on RPC_WIFI_USE_STATIC_IP

config RPC_WIFI_STATIC_DNS1
    string "Static DNS server 1"
    default "8.8.8.8"
    depends on RPC_WIFI_USE_STATIC_IP

config RPC_WIFI_STATIC_DNS2
    string "Static DNS server 2"
    default "1.1.1.1"
    depends on RPC_WIFI_USE_STATIC_IP

config RPC_API_AUTH_TOKEN
    string "API auth token"
    default ""

config RPC_SERVO_GPIO
    int "Servo signal GPIO"
    range 0 48
    default 14

config RPC_SERVO_MIN_PULSE_US
    int "Servo minimum pulse width (us)"
    range 300 1000
    default 500

config RPC_SERVO_MAX_PULSE_US
    int "Servo maximum pulse width (us)"
    range 1500 3000
    default 2500

config RPC_SERVO_MIN_ANGLE
    int "Servo minimum angle"
    range -90 0
    default 0

config RPC_SERVO_MAX_ANGLE
    int "Servo maximum angle"
    range 90 180
    default 180

config RPC_SERVO_REST_ANGLE
    int "Servo rest angle"
    range -90 180
    default 0

config RPC_SERVO_PRESS_ANGLE
    int "Legacy default press angle"
    range -90 180
    default 65

config RPC_SERVO_READY_ANGLE
    int "Servo ready angle"
    range -90 180
    default RPC_SERVO_REST_ANGLE

config RPC_SERVO_SHORT_PRESS_ANGLE
    int "Servo short press angle"
    range -90 180
    default RPC_SERVO_PRESS_ANGLE

config RPC_SERVO_LONG_PRESS_ANGLE
    int "Servo long press angle"
    range -90 180
    default RPC_SERVO_PRESS_ANGLE

config RPC_SHORT_PRESS_MS
    int "Short press duration (ms)"
    range 50 2000
    default 250

config RPC_LONG_PRESS_MS
    int "Long press duration (ms)"
    range 1000 10000
    default 6000

config RPC_SERVO_PREPARE_SETTLE_MS
    int "Servo prepare settle delay (ms)"
    range 0 3000
    default 150

config RPC_SERVO_RELEASE_SETTLE_MS
    int "Servo release settle delay (ms)"
    range 0 3000
    default 150

config RPC_HOST_HEARTBEAT_TIMEOUT_SEC
    int "Host heartbeat timeout (s)"
    range 5 600
    default 45

config RPC_STATUS_LOG_INTERVAL_SEC
    int "Status log interval (s)"
    range 5 300
    default 30

endmenu
```

## sdkconfig.defaults
```kconfig
# Enable the built-in certificate bundle so HTTPS webhooks can be verified.
CONFIG_MBEDTLS_CERTIFICATE_BUNDLE=y
CONFIG_MBEDTLS_CERTIFICATE_BUNDLE_DEFAULT_FULL=y

# Match the detected flash size on the connected ESP32-S3 board.
CONFIG_ESPTOOLPY_FLASHSIZE_16MB=y
CONFIG_ESPTOOLPY_FLASHSIZE="16MB"
CONFIG_PARTITION_TABLE_CUSTOM=y
CONFIG_PARTITION_TABLE_CUSTOM_FILENAME="partitions.csv"
CONFIG_BOOTLOADER_APP_ROLLBACK_ENABLE=y

# Enable the fallback setup hotspot so the device stays reachable after Wi-Fi failures.
CONFIG_RPC_WIFI_FALLBACK_AP_ENABLE=y
CONFIG_RPC_WIFI_FALLBACK_AP_SSID="esp32-power-controller-setup"
CONFIG_RPC_WIFI_FALLBACK_AP_PASSWORD="esp32setup"
CONFIG_RPC_WIFI_FALLBACK_AP_CHANNEL=1

# Keep the task watchdog enabled for self-recovery.
CONFIG_ESP_TASK_WDT_EN=y
CONFIG_ESP_TASK_WDT_INIT=y
CONFIG_ESP_TASK_WDT_TIMEOUT_S=10
CONFIG_ESP_TASK_WDT_PANIC=y

# Use GPIO14 for the SG90 servo control signal on this hardware build.
CONFIG_RPC_SERVO_GPIO=14
CONFIG_RPC_SERVO_REST_ANGLE=0
CONFIG_RPC_SERVO_PRESS_ANGLE=65
CONFIG_RPC_SERVO_READY_ANGLE=0
CONFIG_RPC_SERVO_SHORT_PRESS_ANGLE=65
CONFIG_RPC_SERVO_LONG_PRESS_ANGLE=65
CONFIG_RPC_SHORT_PRESS_MS=250
CONFIG_RPC_LONG_PRESS_MS=6000
CONFIG_RPC_SERVO_PREPARE_SETTLE_MS=150
CONFIG_RPC_SERVO_RELEASE_SETTLE_MS=150
```
